## package/batocera/libraries/hamlib/Config.in
```kconfig
config BR2_PACKAGE_HAMLIB
	bool "hamlib"
	select BR2_PACKAGE_LIBUSB
	help
	  Ham radio control libraries and tools for rig, rotor, and amplifier control.

	  https://hamlib.github.io/
```

## package/batocera/utils/rtl-sdr/Config.in
```kconfig
config BR2_PACKAGE_RTL_SDR
	bool "rtl-sdr"
	select BR2_PACKAGE_LIBUSB
	help
	  Utilities and libraries for RTL2832U-based software-defined radio.

	  https://osmocom.org/projects/rtl-sdr
```
